## config/west.yml
```yaml
manifest:
  remotes:
    - name: zmkfirmware
      url-base: https://github.com/zmkfirmware
    - name: badjeff
      url-base: https://github.com/badjeff
    - name: charles
      url-base: https://github.com/charlesmst
    - name: minhe7735 
      url-base: https://github.com/minhe7735
  projects:
    - name: zmk
      remote: zmkfirmware
      revision: main
      import: app/west.yml
    - name: zmk-pmw3610-driver-badjeff
      remote: charles
      revision: main
    - name: prospector-zmk-module
      remote: minhe7735 
      revision: reduce-size
  self:
    path: config
```
